## oe/openembedded/conf/distro/terkos.conf
```bitbake
#-----------------------------------------------------------------------------
#@TYPE: Distribution
#@NAME: TerkOS
#@DESCRIPTION: TerkOS Linux Distribution for Qwerk/TeRK/VexPro
#-----------------------------------------------------------------------------

DISTRO_NAME = "TerkOS"
DISTRO_VERSION = "3.3.1-${SRCDATE}"
DISTRO_REVISION = "1"
DISTRO_PR = ".1"

# Basic distro features
DISTRO_FEATURES = "wifi ext2 vfat alsa usbhost"

#Images built can have two modes:
# 'debug': empty rootpassword, strace included
# 'release' no root password, no strace and gdb by default
DISTRO_TYPE ?= "debug"

# build staging from packages
INHERIT += "packaged-staging"

# Other packaging stuff
INHERIT += "debian package_ipk"

# Enable devshells
INHERIT += "devshell"

# If we're using an .ipk based rootfs, we want to have opkg-nogpg
# installed so postinst script can run
IPKG_VARIANT = "opkg-nogpg"

# Name the generated images in a sane way
IMAGE_NAME = "${DISTRO_NAME}-${IMAGE_BASENAME}-${DISTRO_VERSION}-${MACHINE}"
CACHE ?= "${TMPDIR}/cache/${PREFERRED_LIBC}/${MACHINE}"
DEPLOY_DIR ?= "${TMPDIR}/deploy/${PREFERRED_LIBC}"
DEPLOY_DIR_IMAGE = "${DEPLOY_DIR}/images/${MACHINE}"

# Use C locale only
IMAGE_LINGUAS = ""

# Use 2.6 kernel
KERNEL = "kernel26"
MACHINE_KERNEL_VERSION = "2.6"

# And we use uclibc, for now at least.
PREFERRED_LIBC = "uclibc"

# This seems to be necessary to prevent an error
PREFERRED_PROVIDER_avahi = "avahi"

# Silence a warning during parsing
PREFERRED_PROVIDER_task-bootstrap = "task-bootstrap"

# And some preferred virtuals
PREFERRED_PROVIDER_virtual/db           ?= "db"
PREFERRED_PROVIDER_virtual/db-native    ?= "db-native"
PREFERRED_PROVIDER_virtual/libx11       ?= "libx11"
PREFERRED_PROVIDER_gtk+                 ?= "gtk+"
PREFERRED_PROVIDER_gconf                ?= "gconf-dbus"

# Preferred versions of everything
require conf/distro/include/sane-feed.inc
require conf/distro/include/sane-feed-ipk.inc
require conf/distro/include/sane-toolchain.inc
require conf/distro/include/sane-srcdates.inc
require conf/distro/include/sane-srcrevs.inc
require conf/distro/include/angstrom-2008-preferred-versions.inc

# Need to use this otherwise SDK build fails
PREFERRED_VERSION_curl ?= "7.18.2"
PREFERRED_VERSION_curl-native ?= "7.18.2"

# We want to ship extra debug utils in the rootfs when doing a debug build 
DEBUG_APPS ?= ""
DEBUG_APPS += '${@base_conditional("DISTRO_TYPE", "release", "", "strace procps",d)}'

# Additional content I (only valid if you include task-base)
# distro-feed-configs: configuration files for the online feeds
# util-linux-ng-mount util-linux-ng-umount: busybox mount is broken
# angstrom-libc-fixup-hack: fixes an obscure bug with libc.so symlink
DISTRO_EXTRA_RDEPENDS += "\
  util-linux-ng-mount util-linux-ng-umount \
  angstrom-libc-fixup-hack \
"

# Additional content II (can be masked with BAD_RECOMMENDS)
DISTRO_EXTRA_RRECOMMENDS += " \
    kernel-module-vfat \
    kernel-module-ext2 \
    kernel-module-ext3 \
    kernel-module-af-packet \
    openssh-sftp-server \
"
# Don't include kernel images in rootfs
RDEPENDS_kernel-base ?= ""

# Use OpenSSH
DISTRO_SSH_DAEMON = "openssh"

# Make builds not fail
ANGSTROM_FEED_CONFIGS = ""

# Use ARM instruction set
ARM_INSTRUCTION_SET = "arm"

# These would be the correct binutils and GCC to use for Thumb
#PREFERRED_BINUTILS = "2.18.50.0.7"
#PREFERRED_GCC_VERSION = "4.3.3"
```

## trunk/oe/build/conf/local.conf
```bitbake
# Edit this! (not sure how to pick it up from the environment yet...)
OEBASE = "${HOME}/Projects/TeRK/terkos/oe"

# Where to store sources
DL_DIR = "${OEBASE}/sources"
#INHERIT += " rm_work "

# Make sure you have these installed
ASSUME_PROVIDED += "gdk-pixbuf-csource-native imagemagick-native librsvg-native"

# Which files do we want to parse:
BBFILES := "${OEBASE}/openembedded/recipes/*/*.bb"
BBMASK = ""
 
# What kind of images do we want?
IMAGE_FSTYPES += " jffs2 tar.gz "

# Set TMPDIR instead of defaulting it to $pwd/tmp
TMPDIR = "${OEBASE}/tmp"

# Make use of SMP and fast disks
BB_NUMBER_THREADS = "4"

# Machine type
MACHINE = "qwerk"

# Distribution name
DISTRO = "terkos"

# For building canadian SDK
SDK_ARCH = "i686"
SDK_OS = "mingw32"
SDK_EXEEXT = ".exe"
```

## trunk/oe/openembedded/conf/machine/qwerk.conf
```bitbake
#@TYPE: Machine
#@Name: Charmed Labs Qwerk based on Cirrus Logic EP-93xx Development Platform
#@DESCRIPTION: Machine configuration for Charmed Labs Qwerk based on Cirrus Logic EP-93xx Development Platform

TARGET_ARCH = "arm"

#PREFERRED_PROVIDER_virtual/kernel = "linux-ipac9302"
#PREFERRED_PROVIDER_virtual/kernel = "linux-test"
PREFERRED_PROVIDER_virtual/kernel = "linux"
PREFERRED_VERSION_linux = "2.6.29.2"

#don't try to access tty1
USE_VT = "0"

MACHINE_FEATURES = "kernel26 alsa usbhost redboot"

# used by sysvinit_2
SERIAL_CONSOLE = "57600 ttyAM0"

# used by some images
ROOT_FLASH_SIZE = "8"
# get the erase block size right, and pad it out to avoid junk
EXTRA_IMAGECMD_jffs2 = " --eraseblock=0x20000 --pad=0x60000 "

# Make ext2 rootfs fit in memory...
IMAGE_ROOTFS_SIZE_ext2.gz ?= "16384"

#tune for ep93xx cpus
#can be used for crunch support later on
#require conf/machine/include/tune-ep9312.inc

require conf/machine/include/tune-arm920t.inc
```
